## Documentation/devicetree/bindings/edac/phytium,pe220x-edac.yaml
```yaml
# SPDX-License-Identifier: GPL-2.0-only OR BSD-2-Clause
%YAML 1.2
---
$id: http://devicetree.org/schemas/edac/phytium,pe220x-edac.yaml#
$schema: http://devicetree.org/meta-schemas/core.yaml#

title: Phytium Pe220x SoC EDAC node

maintainers:
  - Zhu Honglei <zhuhonglei1714@phytium.com.cn>
  - Chen Baozi <chenbaozi@phytium.com.cn>

description: |
  EDAC node is defined to describe on-chip error detection and correction for
  Phytium Pe220x SoC.

properties:

  compatible:
    const: phytium,pe220x-edac

  reg:
    maxItems: 3

  interrupts:
    maxItems: 3

required:
  - compatible
  - reg
  - interrupts

additionalProperties: false

examples:
  - |
    #include <dt-bindings/interrupt-controller/irq.h>
    edac: edac@32b28000 {
            compatible = "phytium,pe220x-edac";
            reg = <0x0 0x32b28000 0x0 0x1000>,
                  <0x0 0x31400000 0x0 0x1000>,
                  <0x0 0x31401000 0x0 0x1000>;
            interrupts = <GIC_SPI 0 IRQ_TYPE_LEVEL_HIGH>,
                         <GIC_SPI 1 IRQ_TYPE_LEVEL_HIGH>;
    };
```

## Documentation/devicetree/bindings/edac/phytium-e2000-edac.txt
```
* Phytium E2000 SoC EDAC node

EDAC node is defined to describe on-chip error detection and correction.
The follow error types are supported:

  SoC			- SoC IP's such as Ethernet, SATA, and etc

The following section describes the EDAC DT node binding.

Required properties:
- compatible: Shall be "phytium,e2000-edac".
- reg: Shall be the E2000 RAS resource.
- interrupts: Interrupt-specifier for RAS error IRQ(s).

Example:
	edac: edac@32b28000 {
		compatible = "phytium,e2000-edac";
		reg = <0x0 0x32b28000 0x0 0x1000>,
			<0x0 0x31400000 0x0 0x1000>,
			<0x0 0x31401000 0x0 0x1000>;
		interrupts = <GIC_SPI 0 IRQ_TYPE_LEVEL_HIGH>,
				<GIC_SPI 1 IRQ_TYPE_LEVEL_HIGH>,
	};
```

## Documentation/devicetree/bindings/gpu/phytium,dc.yaml
```yaml
# SPDX-License-Identifier: (GPL-2.0-only OR BSD-2-Clause)
%YAML 1.2
---
$id: http://devicetree.org/schemas/gpu/phytium,dc.yaml#
$schema: http://devicetree.org/meta-schemas/core.yaml#

title: Phytium Display Engine

maintainers:
  - Chen Baozi <chenbaozi@phytium.com.cn>

properties:
  compatible:
    const: phytium,dc

  reg:
    minItems: 1
    maxItems: 2
    description: |
     Physical base address of the registers and length of memory mapped region,
     and optional physical base address and length of reserved system memory.

  interrupts:
    maxItems: 1

  pipe_mask:
    $ref: '/schemas/types.yaml#/definitions/uint32'
    description: specify which pipe is enabled, each bit corresponds to a pipe.

  edp_mask:
    $ref: '/schemas/types.yaml#/definitions/uint32'
    description: specify which pipe is edp port, each bit corresponds to a pipe (0:dp, 1:edp).


required:
  - compatible
  - reg
  - interrupts
  - pipe_mask
  - edp_mask

examples:
  - |
    /memreserve/ 0xf4000000 0x4000000; // (optional)

    dc0@32000000 {
      compatible = "phytium,dc";
      reg = <0x0 0x32000000 0x0 0x8000>,
            <0x0 0xf4000000 0x0 0x4000000>; // (optional)
      interrupts = <GIC_SPI 44 IRQ_TYPE_LEVEL_HIGH>;
      pipe_mask = 0x3;
      edp_mask = 0x0;
    };
```

## Documentation/devicetree/bindings/remoteproc/homo-rproc.txt
```
homogeneous remoteproc driver
==========================================

This driver implements communication between remote processors under a homogeneous CPU architecture(SMP).

Homogeneous RemoteProc Device Node:
=================================
A homo_remoteproc device node is used to represent the remote core instance within SoC.

Required properties:
--------------------
 - compatible : should be "homo,rproc"
 - memory-region: reserved memory which will be used by remote processor

Example:
--------

    reserved-memory {
        #address-cells = <0x2>;
        #size-cells = <0x2>;
        ranges;

        rproc: rproc@b0100000 {
            no-map;
            reg = <0x0 0xb0100000 0x0 0x19900000>;
        };
    };

	remoteproc: remoteproc@0 {
        compatible = "phytium,rproc";
        memory-region = <&rproc>;
    };
```

## Documentation/devicetree/bindings/sound/phytium,hda.yaml
```yaml
# SPDX-License-Identifier: (GPL-2.0-only OR BSD-2-Clause)
%YAML 1.2
---
$id: http://devicetree.org/schemas/sound/phytium,hda.yaml#
$schema: http://devicetree.org/meta-schemas/core.yaml#

title: Phytium HDA controller

description: |
  The High Definition Audio (HDA) block provides a serial interface to
  audio codec. It supports multiple input and output streams.

maintainers:
  - Chen Baozi <chenbaozi@phytium.com.cn>

properties:
  compatible:
    - const: phytium,hda

  reg:
    maxItems: 1

  interrupts:
    description: The interrupt from the HDA controller
    maxItems: 1

  clocks:
    maxItems: 1

  clock-names:
    items:
      - const: phytium_hda_clk

required:
  - compatible
  - reg
  - interrupts
  - clocks
  - clock-names

additionalProperties: false

examples:
  - |
    hda: hda@28206000 {
       compatible = "phytium,hda";
       reg = <0 0x28206000 0x0 0x1000>;
       interrupts = <GIC_SPI 23 IRQ_TYPE_LEVEL_HIGH>;
       clocks = <&sysclk_48mhz>;
       clock-names = "phytium_hda_clk";
    };
```

## Documentation/devicetree/bindings/sound/phytium,i2s.yaml
```yaml
# SPDX-License-Identifier: (GPL-2.0 OR BSD-2-Clause)
%YAML 1.2
---
$id: http://devicetree.org/schemas/sound/phytium,i2s.yaml#
$schema: http://devicetree.org/meta-schemas/core.yaml#

title: Phytium I2S controller

maintainers:
  - Chen Baozi <chenbaozi@phytium.com.cn>

properties:
  compatible:
    const: phytium,i2s

  reg:
    maxItems: 2
    description: |
      It contains two register region. The first one is for physical base
      address and length of I2S controller. The second one is for physical
      base address and length of DMA_BDL controller.

  interrupts:
    description: |
      The interrupt line number for the I2S controller. It should contain
      the DMA_BDL interrupt.
    maxItems: 1

  clocks:
    description: Sampling rate reference clock
    maxItems: 1

  dai-name:
    $ref: /schemas/types.yaml#/definitions/string
    description: it will set dai's name used in driver.

required:
  - compatible
  - reg
  - interrupts
  - clocks
  - dai-name

examples:
  - |
    i2s@28009000 {
      compatible = "phytium,i2s";
      reg = <0x0 0x28009000 0x0 0x1000>, <0x0 0x28005000 0x0 0x1000>;
      interrupts = <GIC_SPI 77 IRQ_TYPE_LEVEL_HIGH>;
      clocks = <&sysclk_600mhz>;
      dai-name = "phytium-i2s-lsd";
    };
```

## sound/soc/phytium/Kconfig
```kconfig
# SPDX-License-Identifier: GPL-2.0
config SND_SOC_PHYTIUM_I2S
	bool "Phytium I2S Device Driver"
	depends on ARCH_PHYTIUM
	help
	 Say Y or M if you want to add support for I2S driver for
	 Phytium I2S device . The device supports 2 channels each
	 for play and record.
```
